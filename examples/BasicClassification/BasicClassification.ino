/**
 * @file BasicClassification.ino
 * @brief Basic Multi-Class Classification Example using tinyISB
 *
 * ============================================================================
 * tinyISB: TinyML Scikit-Learn Inference Engine for Microcontrollers
 * ============================================================================
 *
 * Detailed Walkthrough:
 *  1. Demonstrates external static Tensor Arena buffer allocation (zero heap fragmentation).
 *  2. Shows compile-time cross-platform preprocessor macro header dispatch.
 *  3. Initialises model engine with automatic schema validation and quantization inspection.
 *  4. Executes high-level Scikit-Learn inference API: begin(), predict(), and predict_proba().
 *  5. Measures hardware execution latency in microseconds using micros().
 *
 * Target Boards Verified:
 *  - Raspberry Pi Pico (RP2040 Dual Cortex-M0+ @ 133 MHz)
 *  - Raspberry Pi Pico 2 (RP2350 Dual Cortex-M33 with DSP/FPU @ 150 MHz)
 *  - Espressif ESP32-S3 (Dual Xtensa LX7 @ 240 MHz) & ESP32-C6 (32-bit RISC-V @ 160 MHz)
 *  - Arduino Nano 33 BLE Sense (Nordic nRF52840 Cortex-M4F @ 64 MHz)
 */

#include <Arduino.h>

// ============================================================================
// 1. Cross-Platform Runtime Provider Selection
// ============================================================================
// When compiling for Arduino Nano 33 BLE, the official Arduino Mbed core defines
// ARDUINO_ARDUINO_NANO33BLE, which links against the official Arduino_TensorFlowLite.
// For all other modern platforms (Raspberry Pi Pico, Pico 2, ESP32-S3, ESP32-C6),
// the universal TFLM runtime header is included automatically.
#if defined(ARDUINO_ARDUINO_NANO33BLE)
  #include <TensorFlowLite.h>
#else
  #include <tensorflow-runtime-universal.h>
#endif

// Include tinyISB high-level inference framework
#include <tinyISB.h>

// Include the 16-byte aligned model C-array generated by tools/export_to_tinyisb.py
#include "model_data.h"

// ============================================================================
// 2. Static Tensor Arena Memory Allocation (Zero Dynamic Heap)
// ============================================================================
// Safety-Critical Rule: To guarantee zero heap fragmentation and deterministic
// execution in embedded systems, the Tensor Arena must NOT be allocated with malloc()
// or new(). Instead, provide an external static buffer.
//
// alignas(16) is REQUIRED by ARM CMSIS-NN and TensorFlow Lite Micro kernels
// to allow 128-bit SIMD / vector load-store operations without unaligned memory faults.
constexpr size_t kTensorArenaSize = 4 * 1024; // 4096 bytes (4 KB) is optimal for this MLP
alignas(16) static uint8_t tensor_arena[kTensorArenaSize];

// ============================================================================
// 3. Estimator Instantiation
// ============================================================================
// High-level Scikit-Learn style Classifier estimator.
// Encapsulates model validation, auto-quantization, operator dispatch, and argmax/softmax.
static tinyisb::Classifier classifier;

// Sample 4-channel sensory test feature vector from the test calibration dataset.
// Features represent normalized sensor inputs: [x0, x1, x2, x3].
// Expected Ground Truth Label: Class 2.
static const float kSampleFeatures[4] = {0.9375f, -0.3574f, 0.3241f, 0.4415f};

void setup() {
    // Initialize UART serial communication at 115200 baud
    Serial.begin(115200);

    // Wait up to 3 seconds for the Serial Monitor to attach (useful for native USB MCUs)
    while (!Serial && millis() < 3000) {
        // Yield execution to allow USB CDC enumeration
    }

    Serial.println();
    Serial.println(F("=================================================="));
    Serial.println(F("     tinyISB: Basic Classification Example        "));
    Serial.println(F("=================================================="));

    // ========================================================================
    // 4. Model Initialization & Schema Validation
    // ========================================================================
    // classifier.begin() performs the following operations under the hood:
    //  a) Validates the FlatBuffer schema version via tflite::GetModel().
    //  b) Selects the platform OpResolver (AllOpsResolver on ARM / UniversalOpResolver on ESP32).
    //  c) Instantiates tflite::MicroInterpreter using our static tensor_arena.
    //  d) Calls AllocateTensors() to map activation buffers inside the arena.
    //  e) Extracts tensor shapes, quantization scale factors, and zero-point offsets.
    Serial.println(F("[tinyISB] Initializing model engine..."));
    tinyisb::Status status = classifier.begin(model_data, tensor_arena, kTensorArenaSize);

    // Verify whether initialization succeeded without memory exhaustion
    if (status != tinyisb::Status::OK) {
        Serial.print(F("[ERROR] Classifier initialization failed: "));
        Serial.println(tinyisb::status_to_string(status));
        Serial.println(F("[ERROR] Halting system. Check arena size or model validity."));
        while (true) {
            delay(1000); // Halt execution on fatal initialization failure
        }
    }

    Serial.println(F("[tinyISB] Model initialized successfully!"));

    // Print detailed model metadata: input/output dimensions, tensor types, quantization scale/zero-point
    classifier.print_metadata();

    // ========================================================================
    // 5. Single Benchmark Test Vector Evaluation
    // ========================================================================
    Serial.println(F("\n--- Running Benchmark Single Test Vector ---"));
    Serial.print(F("Test Input: ["));
    for (size_t i = 0; i < 4; ++i) {
        Serial.print(kSampleFeatures[i], 4);
        if (i < 3) Serial.print(F(", "));
    }
    Serial.println(F("] (Expected: Class 2)"));

    // Measure raw inference latency in microseconds
    // micros() provides high-resolution hardware timer readings on ARM/ESP32
    uint32_t t_start = micros();

    // classifier.predict(input_array, length):
    //  - Automatically quantizes float inputs: q = clamp(round(x / scale) + zero_point, -128, 127)
    //  - Copies quantized bytes into TFLM input tensor buffer
    //  - Invokes the neural network forward pass (zero dynamic heap allocation)
    //  - Dequantizes output logits and performs argmax reduction
    //  - Returns predicted class index (0, 1, or 2)
    int predicted_class = classifier.predict(kSampleFeatures, 4);
    uint32_t t_elapsed = micros() - t_start;

    Serial.print(F("Predicted Class : ")); Serial.println(predicted_class);
    Serial.print(F("Inference Time  : ")); Serial.print(t_elapsed); Serial.println(F(" us"));

    // Query class probabilities via Scikit-Learn style predict_proba()
    // Computes numerically stable Softmax normalization: P(c) = exp(z_c - z_max) / sum(exp(z - z_max))
    const size_t n_classes = classifier.num_classes();
    Serial.println(F("Normalized Probabilities (predict_proba):"));
    for (size_t c = 0; c < n_classes; ++c) {
        float prob = classifier.predict_proba(kSampleFeatures, c);
        Serial.print(F("  - Class [")); Serial.print(c); Serial.print(F("]: "));
        Serial.print(prob * 100.0f, 2); Serial.println(F("%"));
    }
    Serial.println(F("==================================================\n"));
}

void loop() {
    static uint32_t iteration = 0;
    iteration++;

    // ========================================================================
    // 6. Real-Time Streaming Ingestion Loop
    // ========================================================================
    // Simulate dynamic live sensory readings by adding controlled Gaussian-like noise
    float live_input[4];
    float noise = (float)(iteration % 10) * 0.02f;
    for (int i = 0; i < 4; ++i) {
        live_input[i] = kSampleFeatures[i] + ((i % 2 == 0) ? noise : -noise);
    }

    // Execute live inference and measure latency
    uint32_t t0 = micros();
    int pred = classifier.predict(live_input, 4);
    uint32_t dt = micros() - t0;

    // Obtain confidence for the predicted class
    float confidence = classifier.predict_proba(live_input, pred);

    // Output formatted telemetry report
    Serial.print(F("[Stream #")); Serial.print(iteration);
    Serial.print(F("] -> Predicted Class: ")); Serial.print(pred);
    Serial.print(F(" | Confidence: ")); Serial.print(confidence * 100.0f, 1);
    Serial.print(F("% | Latency: ")); Serial.print(dt); Serial.println(F(" us"));

    // Delay between streaming samples (2 seconds)
    delay(2000);
}
